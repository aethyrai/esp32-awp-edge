## main/Kconfig.projbuild
```kconfig
menu "AWP Edge Node Configuration"

    config AWP_WIFI_SSID
        string "WiFi SSID"
        default "YOUR_SSID"
        help
            WiFi network name.

    config AWP_WIFI_PASSWORD
        string "WiFi Password"
        default "YOUR_PASSWORD"
        help
            WiFi network password.

    config AWP_UPSTREAM_HOST
        string "Upstream node IP address"
        default "192.168.1.100"
        help
            IP address of the upstream AIOS CORE/NODE to connect to.

    config AWP_UPSTREAM_PORT
        int "Upstream node port"
        default 9000
        help
            AWP port of the upstream node.

    config AWP_LISTEN_PORT
        int "Local AWP listen port"
        default 9200
        help
            Port this edge node listens on for local connections.

    config AWP_NODE_NAME
        string "Node name"
        default "esp32-edge"
        help
            Human-readable name for this edge node.

    config AWP_HDC_CACHE_CAPACITY
        int "HDC cache capacity (vectors)"
        default 64
        help
            Number of HDC vectors to cache locally. Limited by RAM.

    config AWP_SENSOR_POLL_INTERVAL_MS
        int "Sensor poll interval (ms)"
        default 5000
        help
            How often to read sensors and report telemetry.

    config AWP_HEARTBEAT_INTERVAL_MS
        int "Heartbeat interval (ms)"
        default 10000
        help
            How often to send PING to upstream node.

    config AWP_PSK
        string "Pre-shared key (hex, minimum 16 bytes / 32 hex chars)"
        default ""
        help
            Hex-encoded pre-shared key. REQUIRED for secure handshake.

            The PSK is mixed into session-key derivation (KDF(ss || psk)).
            An attacker who does not know the PSK cannot recover the
            session key even with full network control, because the
            ML-KEM handshake alone does not authenticate the upstream.
            A formal audit (docs/audits/formal/REPORT.md, finding F-01)
            showed the protocol reduces to unauthenticated ephemeral KEX
            without a secret PSK.

            Minimum 16 bytes (32 hex chars) is enforced at boot.
            Up to 64 bytes (128 hex chars) supported.

            Can also be provisioned via NVS key "awp_psk" in namespace
            "awp_crypto". NVS provisioning takes priority over Kconfig.

    config AWP_REQUIRE_PSK
        bool "Require PSK at boot (recommended)"
        default y
        help
            When enabled, the device refuses to start without a valid PSK.
            Disabling is only for bring-up and testing against a trusted,
            isolated network; production deployments MUST keep this enabled.

    config AWP_RECONNECT_BACKOFF_MAX_MS
        int "Max reconnect backoff (ms)"
        default 60000
        help
            Maximum delay between reconnection attempts (exponential backoff).

    config AWP_INCLUDE_SELF_TESTS
        bool "Compile and run crypto self-tests on boot"
        default y
        help
            When enabled, 14 crypto self-tests (BLAKE3, XChaCha20-Poly1305,
            ML-KEM-768, replay window, frame roundtrip, tamper detection)
            run at boot and halt the device on failure.

            Disable for production images where the tests have already
            been validated on the exact firmware revision being shipped —
            this strips ~30 KB of test code and vectors from the image
            and reduces attack surface (audit F-08). Build-time validation
            must be performed on an image with this option enabled.

endmenu
```

## sdkconfig.defaults
```kconfig
# AWP Edge Node — sdkconfig defaults

# Target
CONFIG_IDF_TARGET="esp32s3"

# Flash — XIAO ESP32S3 Sense has 8MB flash
CONFIG_ESPTOOLPY_FLASHSIZE="8MB"
CONFIG_ESPTOOLPY_FLASHSIZE_8MB=y

# PSRAM — XIAO ESP32S3 Sense has 8MB octal PSRAM
CONFIG_ESP32S3_SPIRAM_SUPPORT=y
CONFIG_SPIRAM=y
CONFIG_SPIRAM_MODE_OCT=y
CONFIG_SPIRAM_SPEED_80M=y
CONFIG_SPIRAM_BOOT_INIT=y
CONFIG_SPIRAM_USE_MALLOC=y
CONFIG_SPIRAM_MALLOC_ALWAYSINTERNAL=4096
CONFIG_SPIRAM_MALLOC_RESERVE_INTERNAL=65536

# Increase main task stack (ML-KEM keypair + crypto on main)
CONFIG_ESP_MAIN_TASK_STACK_SIZE=32768

# TCP/IP — sized to match AWP_ESP32_MAX_PAYLOAD (256KB). Buffers live in
# internal SRAM so size them deliberately — too small means send_raw thrashes
# on EAGAIN for large frames, too large starves other internal-RAM consumers.
CONFIG_LWIP_TCP_MSS=1460
CONFIG_LWIP_TCP_SND_BUF_DEFAULT=262144
CONFIG_LWIP_TCP_WND_DEFAULT=262144
CONFIG_LWIP_SO_REUSE=y

# FreeRTOS
CONFIG_FREERTOS_HZ=1000

# Log level
CONFIG_LOG_DEFAULT_LEVEL_INFO=y
CONFIG_LOG_DEFAULT_LEVEL=3

# ChaCha20-Poly1305 (for XChaCha20 encryption)
CONFIG_MBEDTLS_CHACHA20_C=y
CONFIG_MBEDTLS_POLY1305_C=y
CONFIG_MBEDTLS_CHACHAPOLY_C=y

# =============================================================================
# Security Hardening — DEVELOPMENT DEFAULTS
# =============================================================================
#
# IMPORTANT: Secure boot, flash encryption, JTAG disable, and download mode
# disable are NOT enabled by default. These burn eFuses on first boot and are
# IRREVERSIBLE. Enable them only on purpose, on a chip you intend to lock down.
#
# To enable production security, create sdkconfig.defaults.production with:
#   CONFIG_SECURE_BOOT=y
#   CONFIG_SECURE_BOOT_V2_ENABLED=y
#   CONFIG_SECURE_FLASH_ENC_ENABLED=y
#   CONFIG_SECURE_FLASH_ENCRYPTION_MODE_RELEASE=y
#   CONFIG_SECURE_DISABLE_ROM_DL_MODE=y
#   CONFIG_NVS_ENCRYPTION=y
# Then build with: idf.py -D SDKCONFIG_DEFAULTS="sdkconfig.defaults;sdkconfig.defaults.production" build
#

# Stack canaries (detect buffer overflows at runtime — safe, no eFuse)
CONFIG_COMPILER_STACK_CHECK_MODE_STRONG=y
CONFIG_COMPILER_STACK_CHECK=y

# WiFi Protected Management Frames (802.11w) — enforced in code via pmf_cfg.required=true
# Blocks deauth/disassoc attacks. No eFuse cost. Requires AP support (aethyr-mesh has it).

# Attack surface reduction — disable unused network components
CONFIG_ESP_WIFI_SOFTAP_SUPPORT=n
CONFIG_HTTPD_MAX_REQ_HDR_LEN=0
CONFIG_ESP_HTTP_CLIENT_ENABLE_HTTPS=n

# Camera — OV2640 on XIAO ESP32S3 Sense
CONFIG_OV2640_SUPPORT=y
CONFIG_CAMERA_TASK_STACK_SIZE=4096

# Partition table — use 8MB single app to fit camera firmware
CONFIG_PARTITION_TABLE_CUSTOM=y
CONFIG_PARTITION_TABLE_CUSTOM_FILENAME="partitions.csv"
```
