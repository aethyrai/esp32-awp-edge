/**
 * AWP Interop Test Vector Generator
 *
 * Produces deterministic wire frames that the Python side must decode
 * identically. Tests encode/decode agreement across implementations.
 *
 * Build:
 *   cc -g -O1 -I../main -I../test -I../components/blake3 \
 *      -DAWP_FUZZ_HOST \
 *      test/test_interop.c main/awp_protocol.c main/awp_stream.c \
 *      components/blake3/blake3.c components/blake3/blake3_portable.c \
 *      components/blake3/blake3_dispatch.c \
 *      -DBLAKE3_NO_SSE2 -DBLAKE3_NO_SSE41 -DBLAKE3_NO_AVX2 -DBLAKE3_NO_AVX512 -DBLAKE3_NO_NEON \
 *      -o test_interop && ./test_interop
 *
 * Output: hex-encoded test vectors that test_interop.py verifies.
 */

#include <stdio.h>
#include <stdlib.h>
#include <string.h>
#include <stdint.h>

#include "awp_protocol.h"

/* Stubs for ESP-IDF logging */
#define ESP_LOGE(tag, fmt, ...) ((void)0)
#define ESP_LOGW(tag, fmt, ...) ((void)0)
#define ESP_LOGI(tag, fmt, ...) ((void)0)
#define ESP_LOGD(tag, fmt, ...) ((void)0)

static void print_hex(const uint8_t *data, size_t len)
{
    for (size_t i = 0; i < len; i++) printf("%02x", data[i]);
}

int main(void)
{
    printf("# AWP Interop Test Vectors\n");
    printf("# Generated by test_interop.c\n");
    printf("# Format: name|hex_wire_frame|expected_node_id|expected_msg_type|expected_payload_hex|expected_flags\n\n");

    uint8_t buf[AWP_HEADER_SIZE + 1024 + AWP_CHECKSUM_SIZE];

    /* --- Vector 1: Minimal PING with empty payload --- */
    {
        awp_frame_t frame;
        memset(&frame, 0, sizeof(frame));
        strncpy(frame.node_id, "testnode001", AWP_NODE_ID_SIZE);
        frame.version = AWP_VERSION;
        frame.msg_type = AWP_MSG_PING;
        frame.flags = 0;
        frame.payload = NULL;
        frame.payload_len = 0;

        size_t wire_len = 0;
        awp_err_t err = awp_encode_frame(&frame, buf, sizeof(buf), &wire_len);
        if (err != AWP_OK) { fprintf(stderr, "FAIL: vector 1 encode\n"); return 1; }

        printf("minimal_ping|");
        print_hex(buf, wire_len);
        printf("|testnode001|0x0001||\n");
    }

    /* --- Vector 2: HELLO with JSON payload --- */
    {
        const char *payload = "{\"node_id\":\"abc123\",\"tier\":1}";
        awp_frame_t frame;
        memset(&frame, 0, sizeof(frame));
        strncpy(frame.node_id, "edgenode42abcdef", AWP_NODE_ID_SIZE);
        frame.version = AWP_VERSION;
        frame.msg_type = AWP_MSG_HELLO;
        frame.flags = AWP_FLAG_REQUIRES_ACK;
        frame.payload = (uint8_t *)payload;
        frame.payload_len = strlen(payload);

        size_t wire_len = 0;
        awp_err_t err = awp_encode_frame(&frame, buf, sizeof(buf), &wire_len);
        if (err != AWP_OK) { fprintf(stderr, "FAIL: vector 2 encode\n"); return 1; }

        printf("hello_with_payload|");
        print_hex(buf, wire_len);
        printf("|edgenode42abcdef|0x00f2|");
        print_hex((const uint8_t *)payload, strlen(payload));
        printf("|0x0008\n");
    }

    /* --- Vector 3: Encrypted flag set (payload is opaque ciphertext) --- */
    {
        uint8_t fake_ct[] = {0xDE, 0xAD, 0xBE, 0xEF, 0xCA, 0xFE, 0x00, 0x01};
        awp_frame_t frame;
        memset(&frame, 0, sizeof(frame));
        strncpy(frame.node_id, "securenode99", AWP_NODE_ID_SIZE);
        frame.version = AWP_VERSION;
        frame.msg_type = AWP_MSG_AGENT_CALL_RESPONSE;
        frame.flags = AWP_FLAG_ENCRYPTED | AWP_FLAG_HDC_ENCLOSED;
        frame.payload = fake_ct;
        frame.payload_len = sizeof(fake_ct);

        size_t wire_len = 0;
        awp_err_t err = awp_encode_frame(&frame, buf, sizeof(buf), &wire_len);
        if (err != AWP_OK) { fprintf(stderr, "FAIL: vector 3 encode\n"); return 1; }

        printf("encrypted_hdc_enclosed|");
        print_hex(buf, wire_len);
        printf("|securenode99|0x0017|");
        print_hex(fake_ct, sizeof(fake_ct));
        printf("|0x0041\n");
    }

    /* --- Vector 4: HDC signature field is always zeros on wire --- */
    {
        awp_frame_t frame;
        memset(&frame, 0, sizeof(frame));
        strncpy(frame.node_id, "hdctest", AWP_NODE_ID_SIZE);
        frame.version = AWP_VERSION;
        frame.msg_type = AWP_MSG_PONG;
        /* Set a non-zero HDC signature in the frame struct */
        memset(frame.hdc_signature, 0xAA, AWP_HDC_SIG_SIZE);
        frame.payload = NULL;
        frame.payload_len = 0;

        size_t wire_len = 0;
        awp_err_t err = awp_encode_frame(&frame, buf, sizeof(buf), &wire_len);
        if (err != AWP_OK) { fprintf(stderr, "FAIL: vector 4 encode\n"); return 1; }

        /* Verify HDC field is zeros on wire (offset 44, 512 bytes) */
        int hdc_nonzero = 0;
        for (int i = 44; i < 44 + 512; i++) {
            if (buf[i] != 0) hdc_nonzero = 1;
        }
        printf("hdc_zeroed_on_wire|");
        print_hex(buf, wire_len);
        printf("|hdctest|0x0002||");
        printf("|hdc_zero=%s\n", hdc_nonzero ? "FAIL" : "OK");
    }

    /* --- Vector 5: Roundtrip — encode then decode --- */
    {
        const char *payload = "test_roundtrip";
        awp_frame_t orig;
        memset(&orig, 0, sizeof(orig));
        strncpy(orig.node_id, "roundtrip01", AWP_NODE_ID_SIZE);
        orig.version = AWP_VERSION;
        orig.msg_type = AWP_MSG_CAPABILITY_ANNOUNCE;
        orig.flags = AWP_FLAG_IS_RESPONSE;
        orig.payload = (uint8_t *)payload;
        orig.payload_len = strlen(payload);

        size_t wire_len = 0;
        awp_err_t err = awp_encode_frame(&orig, buf, sizeof(buf), &wire_len);
        if (err != AWP_OK) { fprintf(stderr, "FAIL: vector 5 encode\n"); return 1; }

        awp_frame_t decoded;
        err = awp_decode_frame(buf, wire_len, &decoded);
        if (err != AWP_OK) { fprintf(stderr, "FAIL: vector 5 decode: %s\n", awp_err_str(err)); return 1; }

        int match = (decoded.msg_type == orig.msg_type &&
                     decoded.flags == orig.flags &&
                     strcmp(decoded.node_id, "roundtrip01") == 0 &&
                     decoded.payload_len == orig.payload_len &&
                     memcmp(decoded.payload, orig.payload, orig.payload_len) == 0);

        printf("roundtrip|");
        print_hex(buf, wire_len);
        printf("|roundtrip01|0x0008|");
        print_hex((const uint8_t *)payload, strlen(payload));
        printf("|roundtrip=%s\n", match ? "OK" : "FAIL");
    }

    printf("\n# All vectors generated successfully.\n");
    return 0;
}
